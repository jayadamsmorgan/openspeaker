## meta-openspeaker/conf/layer.conf
```bitbake
# We have a conf and classes directory, add to BBPATH
BBPATH .= ":${LAYERDIR}"

# We have recipes-* directories, add to BBFILES
BBFILES += "${LAYERDIR}/recipes-*/*/*.bb \
            ${LAYERDIR}/recipes-*/*/*.bbappend"

BBFILE_COLLECTIONS += "meta-openspeaker"
BBFILE_PATTERN_meta-openspeaker = "^${LAYERDIR}/"
BBFILE_PRIORITY_meta-openspeaker = "6"

LAYERDEPENDS_meta-openspeaker = "core meson"
LAYERSERIES_COMPAT_meta-openspeaker = "nanbield"
```
